/******************************************************************************
 *  Copyright © 2019 Shenzhen ECIOT Technology Co., Ltd All Rights Reserved
 *-----------------------------------------------------------------------------
 * @file        ec_core_spi_ssd1306_oled.c
 * @brief       spi ssd1306 oled driver
 * @author      mo@eciot.cn (qq:2201920828,v:eciot_mo)
 * @date        2022-04-09
 * @version     1.0
 ******************************************************************************/

#include "stdint.h"
#include "ec_core_gpio.h"
#include "ec_core_delay.h"

static const uint8_t ec_core_font_8X16[] = {
    0x00, 0x00, 0x00, 0x00, 0x00, 0x00, 0x00, 0x00, 0x00, 0x00, 0x00, 0x00, 0x00, 0x00, 0x00, 0x00, // 0
    0x00, 0x00, 0x00, 0xF8, 0x00, 0x00, 0x00, 0x00, 0x00, 0x00, 0x00, 0x33, 0x30, 0x00, 0x00, 0x00, //! 1
    0x00, 0x10, 0x0C, 0x06, 0x10, 0x0C, 0x06, 0x00, 0x00, 0x00, 0x00, 0x00, 0x00, 0x00, 0x00, 0x00, //" 2
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    0x00, 0x06, 0x01, 0x01, 0x02, 0x02, 0x04, 0x04, 0x00, 0x00, 0x00, 0x00, 0x00, 0x00, 0x00, 0x00, //~ 94
};

static ec_core_gpio_pin_e ec_core_spi_sclk_pin;
static ec_core_gpio_pin_e ec_core_spi_mosi_pin;
static ec_core_gpio_pin_e ec_core_ssd1306_rst_pin;
static ec_core_gpio_pin_e ec_core_ssd1306_dc_pin;

static void ec_core_spi_sclk_h(void)
{
    ec_core_gpio_write(ec_core_spi_sclk_pin, EC_CORE_GPIO_LEVEL_H);
}
static void ec_core_spi_sclk_l(void)
{
    ec_core_gpio_write(ec_core_spi_sclk_pin, EC_CORE_GPIO_LEVEL_L);
}
static void ec_core_spi_mosi_h(void)
{
    ec_core_gpio_write(ec_core_spi_mosi_pin, EC_CORE_GPIO_LEVEL_H);
}
static void ec_core_spi_mosi_l(void)
{
    ec_core_gpio_write(ec_core_spi_mosi_pin, EC_CORE_GPIO_LEVEL_L);
}
static void ec_core_ssd1306_rst_h(void)
{
    ec_core_gpio_write(ec_core_ssd1306_rst_pin, EC_CORE_GPIO_LEVEL_H);
}
static void ec_core_ssd1306_rst_l(void)
{
    ec_core_gpio_write(ec_core_ssd1306_rst_pin, EC_CORE_GPIO_LEVEL_L);
}
static void ec_core_ssd1306_dc_h(void)
{
    ec_core_gpio_write(ec_core_ssd1306_dc_pin, EC_CORE_GPIO_LEVEL_H);
}
static void ec_core_ssd1306_dc_l(void)
{
    ec_core_gpio_write(ec_core_ssd1306_dc_pin, EC_CORE_GPIO_LEVEL_L);
}

static void ec_core_spi_ssd1306_oled_delay(uint8_t n)
{
    ec_core_delay_ms(n);
}

static void ec_core_spi_send_byte(uint8_t dat)
{
    uint8_t temp = 0;
    for (uint8_t i = 0; i < 8; i++) //发送一个八位数据
    {
        ec_core_spi_sclk_l();
        temp = dat & 0x80;
        if (temp)
            ec_core_spi_mosi_h();
        else
            ec_core_spi_mosi_l();
        ec_core_spi_sclk_h();
        dat <<= 1;
    }
}

static void ec_core_spi_ssd1306_send_data(uint8_t dat)
{
    ec_core_ssd1306_dc_h();
    ec_core_spi_send_byte(dat);
}

static void ec_core_spi_ssd1306_send_cmd(uint8_t cmd)
{
    ec_core_ssd1306_dc_l();
    ec_core_spi_send_byte(cmd);
}

static void ec_core_spi_ssd1306_oled_set_pos(uint8_t x, uint8_t y)
{
    ec_core_spi_ssd1306_send_cmd(0xb0 + y);
    ec_core_spi_ssd1306_send_cmd(((x & 0xf0) >> 4) | 0x10);
    ec_core_spi_ssd1306_send_cmd((x & 0x0f) | 0x01);
}

static void ec_core_spi_ssd1306_oled_clear(uint8_t dat)
{
    for (uint8_t y = 0; y < 8; y++)
    {
        ec_core_spi_ssd1306_send_cmd(0xb0 + y);
        ec_core_spi_ssd1306_send_cmd(0x01);
        ec_core_spi_ssd1306_send_cmd(0x10);
        for (uint8_t x = 0; x < 128; x++)
            ec_core_spi_ssd1306_send_data(dat);
    }
}

void ec_core_spi_ssd1306_oled_init(ec_core_gpio_pin_e sckl, ec_core_gpio_pin_e mosi, ec_core_gpio_pin_e rst, ec_core_gpio_pin_e dc)
{
    ec_core_spi_sclk_pin = sckl;
    ec_core_spi_mosi_pin = mosi;
    ec_core_ssd1306_rst_pin = rst;
    ec_core_ssd1306_dc_pin = dc;

    ec_core_gpio_out_init(ec_core_spi_sclk_pin, EC_CORE_GPIO_LEVEL_H);
    ec_core_gpio_out_init(ec_core_spi_mosi_pin, EC_CORE_GPIO_LEVEL_H);
    ec_core_gpio_out_init(ec_core_ssd1306_rst_pin, EC_CORE_GPIO_LEVEL_H);
    ec_core_gpio_out_init(ec_core_ssd1306_dc_pin, EC_CORE_GPIO_LEVEL_H);

    ec_core_ssd1306_rst_l();
    ec_core_spi_ssd1306_oled_delay(50);
    ec_core_ssd1306_rst_h(); //从上电到下面开始初始化要有足够的时间，即等待RC复位完毕

    ec_core_spi_ssd1306_send_cmd(0xae); //--turn off oled panel
    ec_core_spi_ssd1306_send_cmd(0x00); //---set low column address
    ec_core_spi_ssd1306_send_cmd(0x10); //---set high column address
    ec_core_spi_ssd1306_send_cmd(0x40); //--set start line address  Set Mapping RAM Display Start Line (0x00~0x3F)
    ec_core_spi_ssd1306_send_cmd(0x81); //--set contrast control register
    ec_core_spi_ssd1306_send_cmd(0xcf); // Set SEG Output Current Brightness
    ec_core_spi_ssd1306_send_cmd(0xa1); //--Set SEG/Column Mapping     0xa0左右反置 0xa1正常
    ec_core_spi_ssd1306_send_cmd(0xc8); // Set COM/Row Scan Direction   0xc0上下反置 0xc8正常
    ec_core_spi_ssd1306_send_cmd(0xa6); //--set normal display
    ec_core_spi_ssd1306_send_cmd(0xa8); //--set multiplex ratio(1 to 64)
    ec_core_spi_ssd1306_send_cmd(0x3f); //--1/64 duty
    ec_core_spi_ssd1306_send_cmd(0xd3); //-set display offset    Shift Mapping RAM Counter (0x00~0x3F)
    ec_core_spi_ssd1306_send_cmd(0x00); //-not offset
    ec_core_spi_ssd1306_send_cmd(0xd5); //--set display clock divide ratio/oscillator frequency
    ec_core_spi_ssd1306_send_cmd(0x80); //--set divide ratio, Set Clock as 100 Frames/Sec
    ec_core_spi_ssd1306_send_cmd(0xd9); //--set pre-charge period
    ec_core_spi_ssd1306_send_cmd(0xf1); // Set Pre-Charge as 15 Clocks & Discharge as 1 Clock
    ec_core_spi_ssd1306_send_cmd(0xda); //--set com pins hardware configuration
    ec_core_spi_ssd1306_send_cmd(0x12); //
    ec_core_spi_ssd1306_send_cmd(0xdb); //--set vcomh
    ec_core_spi_ssd1306_send_cmd(0x40); // Set VCOM Deselect Level
    ec_core_spi_ssd1306_send_cmd(0x20); //-Set Page Addressing Mode (0x00/0x01/0x02)
    ec_core_spi_ssd1306_send_cmd(0x02); //
    ec_core_spi_ssd1306_send_cmd(0x8d); //--set Charge Pump enable/disable
    ec_core_spi_ssd1306_send_cmd(0x14); //--set(0x10) disable
    ec_core_spi_ssd1306_send_cmd(0xa4); // Disable Entire Display On (0xa4/0xa5)
    ec_core_spi_ssd1306_send_cmd(0xa6); // Disable Inverse Display On (0xa6/a7)
    ec_core_spi_ssd1306_send_cmd(0xaf); //--turn on oled panel

    ec_core_spi_ssd1306_oled_clear(0); //初始清屏
    ec_core_spi_ssd1306_oled_set_pos(0, 0);
}

void ec_core_spi_ssd1306_oled_show_string(uint8_t x, uint8_t y, uint8_t *str)
{
    uint8_t c = 0, i = 0, j = 0;
    while (str[j] != '\0')
    {
        c = str[j] - 32;
        if (x > 120)
        {
            x = 0;
            y++;
        }
        ec_core_spi_ssd1306_oled_set_pos(x, y);
        for (i = 0; i < 8; i++)
            ec_core_spi_ssd1306_send_data(ec_core_font_8X16[c * 16 + i]);
        ec_core_spi_ssd1306_oled_set_pos(x, y + 1);
        for (i = 0; i < 8; i++)
            ec_core_spi_ssd1306_send_data(ec_core_font_8X16[c * 16 + i + 8]);
        x += 8;
        j++;
    }
}
